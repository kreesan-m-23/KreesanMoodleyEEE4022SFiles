
/**
  ******************************************************************************
  * @file           : main.c
  * @brief          : Main program body
  ******************************************************************************
  ** This notice applies to any and all portions of this file
  * that are not between comment pairs USER CODE BEGIN and
  * USER CODE END. Other portions of this file, whether 
  * inserted by the user or by software development tools
  * are owned by their respective copyright owners.
  *
  * COPYRIGHT(c) 2018 STMicroelectronics
  *
  * Redistribution and use in source and binary forms, with or without modification,
  * are permitted provided that the following conditions are met:
  *   1. Redistributions of source code must retain the above copyright notice,
  *      this list of conditions and the following disclaimer.
  *   2. Redistributions in binary form must reproduce the above copyright notice,
  *      this list of conditions and the following disclaimer in the documentation
  *      and/or other materials provided with the distribution.
  *   3. Neither the name of STMicroelectronics nor the names of its contributors
  *      may be used to endorse or promote products derived from this software
  *      without specific prior written permission.
  *
  * THIS SOFTWARE IS PROVIDED BY THE COPYRIGHT HOLDERS AND CONTRIBUTORS "AS IS"
  * AND ANY EXPRESS OR IMPLIED WARRANTIES, INCLUDING, BUT NOT LIMITED TO, THE
  * IMPLIED WARRANTIES OF MERCHANTABILITY AND FITNESS FOR A PARTICULAR PURPOSE ARE
  * DISCLAIMED. IN NO EVENT SHALL THE COPYRIGHT HOLDER OR CONTRIBUTORS BE LIABLE
  * FOR ANY DIRECT, INDIRECT, INCIDENTAL, SPECIAL, EXEMPLARY, OR CONSEQUENTIAL
  * DAMAGES (INCLUDING, BUT NOT LIMITED TO, PROCUREMENT OF SUBSTITUTE GOODS OR
  * SERVICES; LOSS OF USE, DATA, OR PROFITS; OR BUSINESS INTERRUPTION) HOWEVER
  * CAUSED AND ON ANY THEORY OF LIABILITY, WHETHER IN CONTRACT, STRICT LIABILITY,
  * OR TORT (INCLUDING NEGLIGENCE OR OTHERWISE) ARISING IN ANY WAY OUT OF THE USE
  * OF THIS SOFTWARE, EVEN IF ADVISED OF THE POSSIBILITY OF SUCH DAMAGE.
  *
  ******************************************************************************
  */
/* Includes ------------------------------------------------------------------*/
#include "main.h"
#include "stm32f4xx_hal.h"

/* USER CODE BEGIN Includes */

/* USER CODE END Includes */

/* Private variables ---------------------------------------------------------*/
ADC_HandleTypeDef hadc1;

DAC_HandleTypeDef hdac;

TIM_HandleTypeDef htim2;

/* USER CODE BEGIN PV */
/* Private variables ---------------------------------------------------------*/

/* USER CODE END PV */

/* Private function prototypes -----------------------------------------------*/
void SystemClock_Config(void);
static void MX_GPIO_Init(void);
static void MX_DAC_Init(void);
static void MX_TIM2_Init(void);
static void MX_ADC1_Init(void);

/* USER CODE BEGIN PFP */
/* Private function prototypes -----------------------------------------------*/

/* USER CODE END PFP */

/* USER CODE BEGIN 0 */
	uint16_t length_of_array = 60000; // Length of Arrays to be Referenced
	uint16_t adc_val[60000]; // Array to Store Incoming Pulses Using the ADC
	uint16_t adc_counter = 0; // Counter to Reference ADC Array
	uint16_t target_one[60000]; // Array to Reference to Simulate False Target One
	uint16_t target_one_counter = 0; // Counter to Refernce False Target One's Array
	uint16_t target_one_delay_counter = 0; // Counter to Create Desired Delay to Insert False Target One
	uint16_t target_one_delay = (int)1*1749; // First Delay of 0.5 meters. Delay in samples for 1 meter delay = ((2*1)/343)[(m)/(m/s)]*(samples/s)
	uint16_t target_two[60000]; // Array to Reference to Simulate False Target Two
	uint16_t target_two_counter = 0; // Counter to Refernce False Target Two's Array
	uint16_t target_two_delay_counter = 0; // Counter to Create Desired Delay to Insert False Target Two
	uint16_t target_two_delay = (int)2*1749; // First Delay of 1.5 meters. Delay in samples for 1 meter delay = ((2*1)/343)[(m)/(m/s)]*(samples/s)
	uint16_t target_one_delay_array[3] = {(int)1*1749, (int)3*1749,(int)4*1749}; // Changing Delays of False Target One
	uint8_t target_one_delay_array_indexer = 0; // Counter to Track Selected Delay of False Target One
	uint16_t target_two_delay_array[3] = {(int)2*1749,(int)4*1749, (int)5*1749}; // Changing Delays of False Target One
	uint8_t target_two_delay_array_indexer = 0; // Counter to Track Selected Delay of False Target One
	uint32_t delay_changer = 0; // Counter to Change Desired Locations of False Targets Periodically
	uint8_t alternator = 0; // Selector to Choose Whether False Target One or Two Gets Sampled Out of the DAC
	uint8_t target_selector = 0; // Selector to Choose Whether Stationary, Approaching or Receding False Targets Get Sampled Out of the DAC
	
	uint16_t adc_val_current = 0; // Current ADC Sample to be Checked in Order to Know When to Send Pulses to Insert Moving False Targets
	
	uint8_t num_pulse_approaching = 1; // Number of Current Pulse in a Line of Pulses to be Transmitted
	uint16_t once_off_delay_approaching = 0; // Once-off Delay to Insert Approaching False Target at Desired Distance
	uint16_t delay_approaching = 0; // Delay to Insert Approaching False Target at Desired Radial Velocity
	uint16_t delay_counter_approaching = 0; // Counter for Delay to Acheive Desired Radial Velocity of False Target
	uint16_t pulse_counter_approaching = 0; // Counter to Keep Track of How Many Pulses were Transmitted
	
	uint8_t num_pulse_receding = 1; // Number of Current Pulse in a Line of Pulses to be Transmitted
	uint16_t once_off_delay_receding = 0; // Once-off Delay to Insert Receding False Target at Desired Distance
	uint16_t delay_receding = 0; // Delay to Insert Receding False Target at Desired Radial Velocity
	uint16_t delay_counter_receding = 0; // Counter for Delay to Acheive Desired Radial Velocity of False Target
	uint16_t pulse_counter_receding = 0; // Counter to Keep Track of How Many Pulses were Transmitted
	
	uint16_t pulse[3000] = {1775, // Pulse Sampled at 100 kHz
2432,
2927,
3137,
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840,
};
	
/* USER CODE END 0 */

/**
  * @brief  The application entry point.
  *
  * @retval None
  */
int main(void)
{
  /* USER CODE BEGIN 1 */

  /* USER CODE END 1 */

  /* MCU Configuration----------------------------------------------------------*/

  /* Reset of all peripherals, Initializes the Flash interface and the Systick. */
  HAL_Init();

  /* USER CODE BEGIN Init */

  /* USER CODE END Init */

  /* Configure the system clock */
  SystemClock_Config();

  /* USER CODE BEGIN SysInit */

  /* USER CODE END SysInit */

  /* Initialize all configured peripherals */
  MX_GPIO_Init();
  MX_DAC_Init();
  MX_TIM2_Init();
  MX_ADC1_Init();
  /* USER CODE BEGIN 2 */
	HAL_TIM_Base_Start(&htim2); // Start Timer 2
	HAL_ADC_Start_IT(&hadc1); // Start ADC Interrupt Generated by Timer Interrupt
	HAL_DAC_Start(&hdac, DAC_CHANNEL_2); // Start DAC
  /* USER CODE END 2 */

  /* Infinite loop */
  /* USER CODE BEGIN WHILE */
  while (1)
  {

  /* USER CODE END WHILE */

  /* USER CODE BEGIN 3 */

  }
  /* USER CODE END 3 */

}

/**
  * @brief System Clock Configuration
  * @retval None
  */
void SystemClock_Config(void)
{

  RCC_OscInitTypeDef RCC_OscInitStruct;
  RCC_ClkInitTypeDef RCC_ClkInitStruct;

    /**Configure the main internal regulator output voltage 
    */
  __HAL_RCC_PWR_CLK_ENABLE();

  __HAL_PWR_VOLTAGESCALING_CONFIG(PWR_REGULATOR_VOLTAGE_SCALE1);

    /**Initializes the CPU, AHB and APB busses clocks 
    */
  RCC_OscInitStruct.OscillatorType = RCC_OSCILLATORTYPE_HSE;
  RCC_OscInitStruct.HSEState = RCC_HSE_ON;
  RCC_OscInitStruct.PLL.PLLState = RCC_PLL_ON;
  RCC_OscInitStruct.PLL.PLLSource = RCC_PLLSOURCE_HSE;
  RCC_OscInitStruct.PLL.PLLM = 8;
  RCC_OscInitStruct.PLL.PLLN = 336;
  RCC_OscInitStruct.PLL.PLLP = RCC_PLLP_DIV2;
  RCC_OscInitStruct.PLL.PLLQ = 7;
  if (HAL_RCC_OscConfig(&RCC_OscInitStruct) != HAL_OK)
  {
    _Error_Handler(__FILE__, __LINE__);
  }

    /**Initializes the CPU, AHB and APB busses clocks 
    */
  RCC_ClkInitStruct.ClockType = RCC_CLOCKTYPE_HCLK|RCC_CLOCKTYPE_SYSCLK
                              |RCC_CLOCKTYPE_PCLK1|RCC_CLOCKTYPE_PCLK2;
  RCC_ClkInitStruct.SYSCLKSource = RCC_SYSCLKSOURCE_PLLCLK;
  RCC_ClkInitStruct.AHBCLKDivider = RCC_SYSCLK_DIV1;
  RCC_ClkInitStruct.APB1CLKDivider = RCC_HCLK_DIV8;
  RCC_ClkInitStruct.APB2CLKDivider = RCC_HCLK_DIV8;

  if (HAL_RCC_ClockConfig(&RCC_ClkInitStruct, FLASH_LATENCY_5) != HAL_OK)
  {
    _Error_Handler(__FILE__, __LINE__);
  }

    /**Configure the Systick interrupt time 
    */
  HAL_SYSTICK_Config(HAL_RCC_GetHCLKFreq()/1000);

    /**Configure the Systick 
    */
  HAL_SYSTICK_CLKSourceConfig(SYSTICK_CLKSOURCE_HCLK);

  /* SysTick_IRQn interrupt configuration */
  HAL_NVIC_SetPriority(SysTick_IRQn, 0, 0);
}

/* ADC1 init function */
static void MX_ADC1_Init(void)
{

  ADC_ChannelConfTypeDef sConfig;

    /**Configure the global features of the ADC (Clock, Resolution, Data Alignment and number of conversion) 
    */
  hadc1.Instance = ADC1;
  hadc1.Init.ClockPrescaler = ADC_CLOCK_SYNC_PCLK_DIV2;
  hadc1.Init.Resolution = ADC_RESOLUTION_12B;
  hadc1.Init.ScanConvMode = DISABLE;
  hadc1.Init.ContinuousConvMode = DISABLE;
  hadc1.Init.DiscontinuousConvMode = DISABLE;
  hadc1.Init.ExternalTrigConvEdge = ADC_EXTERNALTRIGCONVEDGE_RISING;
  hadc1.Init.ExternalTrigConv = ADC_EXTERNALTRIGCONV_T2_TRGO;
  hadc1.Init.DataAlign = ADC_DATAALIGN_RIGHT;
  hadc1.Init.NbrOfConversion = 1;
  hadc1.Init.DMAContinuousRequests = DISABLE;
  hadc1.Init.EOCSelection = ADC_EOC_SINGLE_CONV;
  if (HAL_ADC_Init(&hadc1) != HAL_OK)
  {
    _Error_Handler(__FILE__, __LINE__);
  }

    /**Configure for the selected ADC regular channel its corresponding rank in the sequencer and its sample time. 
    */
  sConfig.Channel = ADC_CHANNEL_1;
  sConfig.Rank = 1;
  sConfig.SamplingTime = ADC_SAMPLETIME_3CYCLES;
  if (HAL_ADC_ConfigChannel(&hadc1, &sConfig) != HAL_OK)
  {
    _Error_Handler(__FILE__, __LINE__);
  }

}

/* DAC init function */
static void MX_DAC_Init(void)
{

  DAC_ChannelConfTypeDef sConfig;

    /**DAC Initialization 
    */
  hdac.Instance = DAC;
  if (HAL_DAC_Init(&hdac) != HAL_OK)
  {
    _Error_Handler(__FILE__, __LINE__);
  }

    /**DAC channel OUT2 config 
    */
  sConfig.DAC_Trigger = DAC_TRIGGER_NONE;
  sConfig.DAC_OutputBuffer = DAC_OUTPUTBUFFER_ENABLE;
  if (HAL_DAC_ConfigChannel(&hdac, &sConfig, DAC_CHANNEL_2) != HAL_OK)
  {
    _Error_Handler(__FILE__, __LINE__);
  }

}

/* TIM2 init function */
static void MX_TIM2_Init(void)
{

  TIM_ClockConfigTypeDef sClockSourceConfig;
  TIM_MasterConfigTypeDef sMasterConfig;

  htim2.Instance = TIM2;
  htim2.Init.Prescaler = 13;
  htim2.Init.CounterMode = TIM_COUNTERMODE_UP;
  htim2.Init.Period = 9;
  htim2.Init.ClockDivision = TIM_CLOCKDIVISION_DIV1;
  if (HAL_TIM_Base_Init(&htim2) != HAL_OK)
  {
    _Error_Handler(__FILE__, __LINE__);
  }

  sClockSourceConfig.ClockSource = TIM_CLOCKSOURCE_INTERNAL;
  if (HAL_TIM_ConfigClockSource(&htim2, &sClockSourceConfig) != HAL_OK)
  {
    _Error_Handler(__FILE__, __LINE__);
  }

  sMasterConfig.MasterOutputTrigger = TIM_TRGO_UPDATE;
  sMasterConfig.MasterSlaveMode = TIM_MASTERSLAVEMODE_DISABLE;
  if (HAL_TIMEx_MasterConfigSynchronization(&htim2, &sMasterConfig) != HAL_OK)
  {
    _Error_Handler(__FILE__, __LINE__);
  }

}

/** Configure pins as 
        * Analog 
        * Input 
        * Output
        * EVENT_OUT
        * EXTI
*/
static void MX_GPIO_Init(void)
{

  GPIO_InitTypeDef GPIO_InitStruct;

  /* GPIO Ports Clock Enable */
  __HAL_RCC_GPIOH_CLK_ENABLE();
  __HAL_RCC_GPIOA_CLK_ENABLE();
  __HAL_RCC_GPIOD_CLK_ENABLE();

  /*Configure GPIO pin Output Level */
  HAL_GPIO_WritePin(GPIOD, GPIO_PIN_12|GPIO_PIN_13, GPIO_PIN_RESET);

  /*Configure GPIO pins : PD12 PD13 */
  GPIO_InitStruct.Pin = GPIO_PIN_12|GPIO_PIN_13;
  GPIO_InitStruct.Mode = GPIO_MODE_OUTPUT_PP;
  GPIO_InitStruct.Pull = GPIO_NOPULL;
  GPIO_InitStruct.Speed = GPIO_SPEED_FREQ_LOW;
  HAL_GPIO_Init(GPIOD, &GPIO_InitStruct);

}

/* USER CODE BEGIN 4 */
void HAL_ADC_ConvCpltCallback(ADC_HandleTypeDef* hadc)
{
  /* Prevent unused argument(s) compilation warning */
  UNUSED(hadc);
  /* NOTE : This function Should not be modified, when the callback is needed,
            the HAL_ADC_ConvCpltCallback could be implemented in the user file
   */
	
	adc_val[adc_counter] = HAL_ADC_GetValue(&hadc1);
	adc_counter ++;
	if (adc_counter == length_of_array){adc_counter = 0;}
	
	if (target_selector == 0){ // Insert Stationary False Targets in Radar System
		target_selector = 1;
		
		if ((target_one_delay_counter < target_one_delay) && (target_two_delay_counter < target_two_delay)){
			target_one_delay_counter ++;
			target_two_delay_counter ++;
		}
		
		else if ((target_one_delay_counter < target_one_delay) && (target_two_delay_counter > target_two_delay)){
			target_one_delay_counter ++;
			target_two_delay_counter --;
		}
		
		else if ((target_one_delay_counter > target_one_delay) && (target_two_delay_counter < target_two_delay)){
			target_one_delay_counter --;
			target_two_delay_counter ++;
		}
		
		else if ((target_one_delay_counter > target_one_delay) && (target_two_delay_counter > target_two_delay)){
			target_one_delay_counter --;
			target_two_delay_counter --;
		}
		
		// Insert One False Target One
		else if ((target_one_delay_counter == target_one_delay) && (target_two_delay_counter != target_two_delay)){
			HAL_DAC_SetValue(&hdac, DAC_CHANNEL_2, DAC_ALIGN_12B_R, adc_val[target_one_counter]);
			target_one_counter ++;
			if (target_one_counter == length_of_array){target_one_counter = 0;}
			if (target_two_delay_counter > target_two_delay){target_two_delay_counter --;}
			if (target_two_delay_counter < target_two_delay){target_two_delay_counter ++;}
		}
		
		else if ((target_one_delay_counter != target_one_delay) && (target_two_delay_counter == target_two_delay)){
			HAL_DAC_SetValue(&hdac, DAC_CHANNEL_2, DAC_ALIGN_12B_R, adc_val[target_two_counter]);
			target_two_counter ++;
			if (target_two_counter == length_of_array){target_two_counter = 0;}
			if (target_one_delay_counter > target_one_delay){target_one_delay_counter --;}
			if (target_one_delay_counter < target_one_delay){target_one_delay_counter ++;}
		}
		
		// Insert Two False Targets
		else if ((target_one_delay_counter == target_one_delay) && (target_two_delay_counter == target_two_delay)){
			if (alternator == 0){ // Select First Stationary False Target
				HAL_DAC_SetValue(&hdac, DAC_CHANNEL_2, DAC_ALIGN_12B_R, adc_val[target_one_counter]);
				target_one_counter ++;
				if (target_one_counter == length_of_array){target_one_counter = 0;}
				target_two_counter ++;
				if (target_two_counter == length_of_array){target_two_counter = 0;}
				alternator = 1;
			}
			
			else{ // Select Second Stationary False Target
				HAL_DAC_SetValue(&hdac, DAC_CHANNEL_2, DAC_ALIGN_12B_R, adc_val[target_two_counter]);
				target_one_counter ++;
				if (target_one_counter == length_of_array){target_one_counter = 0;}
				target_two_counter ++;
				if (target_two_counter == length_of_array){target_two_counter = 0;}
				alternator = 0;
			}
		}
	}
	
	else if (target_selector == 1){ // Insert Approaching False Target in Radar System
		target_selector = 2;
		
		target_one_counter ++;
		if (target_one_counter == length_of_array){target_one_counter = 0;}
		target_two_counter ++;
		if (target_two_counter == length_of_array){target_two_counter = 0;}
		
		if ((target_one_delay_counter < target_one_delay) && (target_two_delay_counter < target_two_delay)){
			target_one_delay_counter ++;
			target_two_delay_counter ++;
		}
		
		else if ((target_one_delay_counter < target_one_delay) && (target_two_delay_counter > target_two_delay)){
			target_one_delay_counter ++;
			target_two_delay_counter --;
		}
		
		else if ((target_one_delay_counter > target_one_delay) && (target_two_delay_counter < target_two_delay)){
			target_one_delay_counter --;
			target_two_delay_counter ++;
		}
		
		else if ((target_one_delay_counter > target_one_delay) && (target_two_delay_counter > target_two_delay)){
			target_one_delay_counter --;
			target_two_delay_counter --;
		}
		
		if (adc_val_current > 3000){
		HAL_GPIO_WritePin(GPIOD, GPIO_PIN_12, 1);
		
		delay_approaching = (int)(100000*(0.03-(0.000011 * 1))); // (*insert speed in cm/s here* * 1). 2.5 cm/s = 0.000001 5 cm/s = 0.000011 10 cm/s = 0.000024. Found Empirically.
		if (once_off_delay_approaching == (int)((3.3+7) * 583.09)){ // (3.3 + *insert desired distance here*). Found Empirically.
			if (delay_counter_approaching == delay_approaching){
				HAL_DAC_SetValue(&hdac, DAC_CHANNEL_2, DAC_ALIGN_12B_R, pulse[pulse_counter_approaching]);
				pulse_counter_approaching ++;
				if (pulse_counter_approaching == 3000){
					pulse_counter_approaching = 0;
					delay_counter_approaching = 0;
					num_pulse_approaching ++;
					if (num_pulse_approaching == 36){
						num_pulse_approaching = 1;
						adc_val_current = 0;
						once_off_delay_approaching = 0;
					}
				}
			}
			
			else {delay_counter_approaching ++;}
		}
		else {once_off_delay_approaching ++;}
	}
	
		else {
			adc_val_current = HAL_ADC_GetValue(&hadc1);
			HAL_GPIO_WritePin(GPIOD, GPIO_PIN_12, 0);
		}
	}
	
	else if (target_selector == 2){ // Insert Receding False Target in Radar System
		target_selector = 0;
		
		target_one_counter ++;
		if (target_one_counter == length_of_array){target_one_counter = 0;}
		target_two_counter ++;
		if (target_two_counter == length_of_array){target_two_counter = 0;}
		
		if ((target_one_delay_counter < target_one_delay) && (target_two_delay_counter < target_two_delay)){
			target_one_delay_counter ++;
			target_two_delay_counter ++;
		}
		
		else if ((target_one_delay_counter < target_one_delay) && (target_two_delay_counter > target_two_delay)){
			target_one_delay_counter ++;
			target_two_delay_counter --;
		}
		
		else if ((target_one_delay_counter > target_one_delay) && (target_two_delay_counter < target_two_delay)){
			target_one_delay_counter --;
			target_two_delay_counter ++;
		}
		
		else if ((target_one_delay_counter > target_one_delay) && (target_two_delay_counter > target_two_delay)){
			target_one_delay_counter --;
			target_two_delay_counter --;
		}
		
		if (adc_val_current > 3000){
		HAL_GPIO_WritePin(GPIOD, GPIO_PIN_12, 1);
		
		delay_receding = (int)(100000*(0.03+(0.000020* 1))); // (*insert speed in cm/s here* * 1). -2.5 cm/s = 0.000010 -5 cm/s = 0.000020 -10 cm/s = 0.000030. Found Empirically.
		if (once_off_delay_receding == (int)((3.3+7)*583.09)){ // (3.3 + *insert desired distance here*). Found Empirically.
			if (delay_counter_receding == delay_receding){
				HAL_DAC_SetValue(&hdac, DAC_CHANNEL_2, DAC_ALIGN_12B_R, pulse[pulse_counter_receding]);
				pulse_counter_receding ++;
				if (pulse_counter_receding == 3000){
					pulse_counter_receding = 0;
					delay_counter_receding = 0;
					num_pulse_receding ++;
					if (num_pulse_receding == 36){
						num_pulse_receding = 1;
						adc_val_current = 0;
						once_off_delay_receding = 0;
					}
				}
			}
			
			else {delay_counter_receding ++;}
		}
		else {once_off_delay_receding ++;}
	}
	
		else {
			adc_val_current = HAL_ADC_GetValue(&hadc1);
			HAL_GPIO_WritePin(GPIOD, GPIO_PIN_12, 0);
		}
	}
	// Change Location of False Target Every 10 Seconds
	if (delay_changer == (3000000 - 1)){
		HAL_GPIO_TogglePin(GPIOD, GPIO_PIN_13);
		
		target_one_delay = target_one_delay_array[target_one_delay_array_indexer];
		target_one_delay_array_indexer ++;
		if (target_one_delay_array_indexer == 3){target_one_delay_array_indexer = 0;}
		
		target_two_delay = target_two_delay_array[target_two_delay_array_indexer];
		target_two_delay_array_indexer ++;
		if (target_two_delay_array_indexer == 3){target_two_delay_array_indexer = 0;}
		
		delay_changer = 0;
	}
	else {delay_changer ++;}
	
}
/* USER CODE END 4 */

/**
  * @brief  This function is executed in case of error occurrence.
  * @param  file: The file name as string.
  * @param  line: The line in file as a number.
  * @retval None
  */
void _Error_Handler(char *file, int line)
{
  /* USER CODE BEGIN Error_Handler_Debug */
  /* User can add his own implementation to report the HAL error return state */
  while(1)
  {
  }
  /* USER CODE END Error_Handler_Debug */
}

#ifdef  USE_FULL_ASSERT
/**
  * @brief  Reports the name of the source file and the source line number
  *         where the assert_param error has occurred.
  * @param  file: pointer to the source file name
  * @param  line: assert_param error line source number
  * @retval None
  */
void assert_failed(uint8_t* file, uint32_t line)
{ 
  /* USER CODE BEGIN 6 */
  /* User can add his own implementation to report the file name and line number,
     tex: printf("Wrong parameters value: file %s on line %d\r\n", file, line) */
  /* USER CODE END 6 */
}
#endif /* USE_FULL_ASSERT */

/**
  * @}
  */

/**
  * @}
  */

/************************ (C) COPYRIGHT STMicroelectronics *****END OF FILE****/
